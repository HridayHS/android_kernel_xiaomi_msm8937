## drivers/input/touchscreen/IST30xx/Kconfig
```kconfig
config TOUCHSCREEN_IST30XX
	bool "IMAGES IST30XX touchpanel driver"
	depends on CONFIG_INPUT_TOUCHSCREEN
	default n
```

## drivers/platform/xiaomi/Kconfig
```kconfig
# Xiaomi configuration options

config MACH_XIAOMI_MSM8937
	bool "Xiaomi MSM8937"
	depends on ARCH_MSM8937
	help
	  Support for MSM8937 Xiaomi variants

menu "Xiaomi board selection"

config MACH_XIAOMI_LAND
	bool "Land board"
	select MACH_XIAOMI_MSM8937
	help
	  Support for Redmi 3S/3X

endmenu
```
